#include <stdlib.h>
#include <string.h>
#include "cmsis_os.h"
#include "chip8.h"
#include "rng.h"
#include "lcd.h"

chip8_t chip8_emulator;

uint8_t testopcode[478] =
{
	0x12, 0x4e, 0xea, 0xac, 0xaa, 0xea, 0xce, 0xaa, 
	0xaa, 0xae, 0xe0, 0xa0, 0xa0, 0xe0, 0xc0, 0x40, 
	0x40, 0xe0, 0xe0, 0x20, 0xc0, 0xe0, 0xe0, 0x60, 
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	0xd9, 0xb4, 0x12, 0x48, 0x13, 0xdc, 
};

uint8_t testkeypad[913] =
{
	0x13, 0x0c, 0x60, 0x00, 0xe0, 0xa1, 0x12, 0x04, 
	0x70, 0x01, 0x40, 0x10, 0x00, 0xee, 0x12, 0x04, 
	0x65, 0x00, 0xa2, 0x22, 0xf1, 0x55, 0xa2, 0x82, 
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	0xb8, 
};

unsigned char Pong1player[246] =
{
	0x6a, 0x02, 0x6b, 0x0c, 0x6c, 0x3f, 0x6d, 0x0c, 
	0xa2, 0xea, 0xda, 0xb6, 0xdc, 0xd6, 0x6e, 0x00, 
	0x22, 0xd4, 0x66, 0x03, 0x68, 0x02, 0x60, 0x60, 
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	0x80, 0x00, 0x00, 0x00, 0x00, 0x00, 
};

uint8_t chip8_keymap[16] = {
    0X19, 0x1E, 0x1F, 0x20, 
    0x21, 0x14, 0x1A, 0x08,  
    0x15, 0x04, 0x16, 0x07,  
    0x09, 0x1D, 0x1B, 0x06,  
};

uint8_t font_base = 0x050;
static const uint8_t font[80] = {
    // 0
    0xF0, 0x90, 0x90, 0x90, 0xF0,
    // 1
    0x20, 0x60, 0x20, 0x20, 0x70,
    // 2
    0xF0, 0x10, 0xF0, 0x80, 0xF0,
    // 3
    0xF0, 0x10, 0xF0, 0x10, 0xF0,
    // 4
    0x90, 0x90, 0xF0, 0x10, 0x10,
    // 5
    0xF0, 0x80, 0xF0, 0x10, 0xF0,
    // 6
    0xF0, 0x80, 0xF0, 0x90, 0xF0,
    // 7
    0xF0, 0x10, 0x20, 0x40, 0x40,
    // 8
    0xF0, 0x90, 0xF0, 0x90, 0xF0,
    // 9
    0xF0, 0x90, 0xF0, 0x10, 0xF0,
    // A
    0xF0, 0x90, 0xF0, 0x90, 0x90,
    // B
    0xE0, 0x90, 0xE0, 0x90, 0xE0,
    // C
    0xF0, 0x80, 0x80, 0x80, 0xF0,
    // D
    0xE0, 0x90, 0x90, 0x90, 0xE0,
    // E
    0xF0, 0x80, 0xF0, 0x80, 0xF0,
    // F
    0xF0, 0x80, 0xF0, 0x80, 0x80
};

void chip8_init(chip8_t *c)
{
    memset(c, 0, sizeof(chip8_t));
    memcpy(&c->chip8_rom[font_base], font, sizeof(font));
    c->pc = 0x200;
}

void chip8_load_rom(chip8_t *c, const uint8_t *rom, uint32_t size)
{
    if (size > sizeof(c->chip8_rom))
        size = sizeof(c->chip8_rom);
    memcpy(&c->chip8_rom[0x200], rom, size); 
}

void chip8_step(chip8_t *c)
{
    int i = 0;
    uint16_t sum = 0;
    uint32_t random = 0;
    uint16_t opcode = (c->chip8_rom[c->pc] << 8)
                    | c->chip8_rom[c->pc + 1];
    c->pc += 2;

    uint8_t  x = (opcode & 0x0F00) >> 8;
    uint8_t  y = (opcode & 0x00F0) >> 4;
    uint8_t  n = opcode & 0x000F;
    uint8_t  nn = opcode & 0x00FF;
    uint16_t nnn = opcode & 0x0FFF;

    switch (opcode & 0xF000)
    {
        case 0x0000:
            switch (nn)
            {
                case 0x00E0:
                    chip8_clear_screen(c);
                    break;
                case 0x00EE:
                    c->pc = c->stack[c->sp--];
                    break;
            }
            break;

        case 0x1000:
            c->pc = nnn;
            break;

        case 0x2000:
            c->stack[++c->sp] = c->pc;
            c->pc = nnn;
            break;
        case 0x3000:
            if (c->V[x] == nn)
                c->pc += 2;
            break;

        case 0x4000:
            if (c->V[x] != nn)
                c->pc += 2;
            break;

        case 0x5000:
            if (c->V[x] == c->V[y])
                c->pc += 2;
            break;

        case 0x6000:
            c->V[x] = nn;
            break;

        case 0x7000:
            c->V[x] += nn;
            break;

        case 0x8000:
            switch (n)
            {
                case 0x0000:
                    c->V[x] = c->V[y];
                    break;
                
                case 0x0001:
                    c->V[x] |= c->V[y];
                    break;
                
                case 0x0002:
                    c->V[x] &= c->V[y];
                    break;
                
                case 0x0003:
                    c->V[x] ^= c->V[y];
                    break;
                
                case 0x0004:
                    sum = c->V[x] + c->V[y];
                    c->V[0xF] = (sum > 0xFF);
                    c->V[x] = sum & 0xFF;
					break;
                
                case 0x0005:
                    c->V[0xF] = (c->V[x] >= c->V[y]);
                    c->V[x] -= c->V[y];
                    break;
                
                case 0x0006:
                    c->V[x] >>= 1;
                    c->V[0xF] = c->V[x] & 0x01;
                    break;
                
                case 0x0007:
                    c->V[0xF] = (c->V[y] >= c->V[x]);
                    c->V[x] = c->V[y] - c->V[x];
                    break;
                
                case 0x000E:
                    c->V[0xF] = (c->V[x] >> 7) & 0x01;
                    c->V[x] <<= 1;
                    break;
            }
            break;

        case 0x9000:
            if (c->V[x] != c->V[y])
                c->pc += 2;
            break;

        case 0xA000:
            c->I = nnn;
            break;

        case 0xB000:
            c->pc = nnn + c->V[0];
            break;
        
        case 0xC000:
            HAL_RNG_GenerateRandomNumber(&hrng, &random);
            c->V[x] = (random % 256) & nn;  
            break;

        case 0xD000:
            chip8_draw(c, c->V[x], c->V[y], n);
            break;

        case 0xE000:
            switch (nn)
            {
                case 0x009E:
                    if (c->keypad[c->V[x]])
                        c->pc += 2;
                    break;
                
                case 0x00A1:
                    if (!c->keypad[c->V[x]])
                        c->pc += 2;
                    break;
            }
            break;
        
        case 0xF000:
            switch (nn)
            {

                case 0x0007:
                    c->V[x] = c->delay_timer;
                    break;

                case 0x000A:
                    for (i = 0; i < 16; i++)
                    {
                        if (c->keypad[i])
                        {
                            c->V[x] = i;
                            break;
                        }
                    }
                    if (i == 16)   
                    {
                        c->pc -= 2;
                        osDelay(10);
                    }
                    break;
                
                case 0x0015:
                    c->delay_timer = c->V[x];
                    break;
                
                case 0x0018:
                    c->sound_timer = c->V[x];
                    break;
                
                case 0x001E:
                    c->I += c->V[x];
                    break;
                
                case 0x0029:
                    c->I = (c->V[x] * 5) + font_base;
                    break;
                
                case 0x0033:
                    c->chip8_rom[c->I] = c->V[x] / 100;
                    c->chip8_rom[c->I + 1] = (c->V[x] / 10) % 10;
                    c->chip8_rom[c->I + 2] = c->V[x] % 10;
                    break;

                case 0x0055:
                    for (int i = 0; i <= x; i++)
                        c->chip8_rom[c->I + i] = c->V[i];
                    break;
                
                case 0x0065:
                    for (int i = 0; i <= x; i++)
                        c->V[i] = c->chip8_rom[c->I + i];
                    break;
            }

    }
}

void chip8_clear_key(chip8_t *c)
{
    for (int i = 0; i < 16; i++)
        c->keypad[i] = 0;
}

void chip8_set_key(chip8_t *c, uint8_t key, uint8_t state)
{
    for (int i = 0; i < 16; i++)
    {
        if (key == chip8_keymap[i])
        {
            c->keypad[i] = state;
            break;
        }
    } 
}

void chip8_clear_screen(chip8_t *c)
{
    memset(c->gfx, 0, sizeof(c->gfx));
}

void chip8_draw(chip8_t *c, uint8_t x, uint8_t y, uint8_t height)
{
    uint8_t vx = x;
    uint8_t vy = y;
    uint8_t row = 0;
    uint8_t col = 0;
    uint8_t px = 0;
    uint8_t py = 0;
    uint16_t idx = 0;
    uint8_t sprite = 0;

    c->V[0xF] = 0;  

    for (row = 0; row < height; row++)
        {
            sprite = c->chip8_rom[c->I + row];

            for (col = 0; col < 8; col++)
            {
                if (sprite & (0x80 >> col))
                {
                    px = (vx + col) & 63;
                    py = (vy + row) & 31;
                    idx = py * 64 + px;

                    if (c->gfx[idx])
                        c->V[0xF] = 1;

                    c->gfx[idx] ^= 1;
                }
            }
        }

    c->draw_flag = 1;
}

void chip8_timer_tick(chip8_t *c)
{
    if (c->delay_timer > 0)
        c->delay_timer--;

    if (c->sound_timer > 0)
        c->sound_timer--;
}
